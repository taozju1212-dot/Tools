#include "app_oled.h"
#include "bsp.h"
#include <string.h>
#include <stdio.h>

/* ============================================================================
 *  SSD1306/SH1106 OLED 驱动 + 帧缓存 + 全自动工装 UI
 * ============================================================================ */

/* ---------- 帧缓存 ---------- */
static uint8_t g_fb[OLED_PAGES][OLED_W];
static uint8_t g_fb_dirty[OLED_PAGES];

/* ============================================================================
 *  I2C 底层（使用 BSP 已初始化的 I2C1 硬件外设）
 * ============================================================================ */

static void I2C_WaitBusy(void)
{
    uint32_t timeout = 10000;
    while (I2C_GetFlagStatus(I2C1, I2C_FLAG_BUSY) && timeout--);
}

static void I2C_WaitEvent(uint32_t event)
{
    uint32_t timeout = 10000;
    while (!I2C_CheckEvent(I2C1, event) && timeout--);
}

static void OLED_WriteCmd(uint8_t cmd)
{
    I2C_WaitBusy();
    I2C_GenerateSTART(I2C1, ENABLE);
    I2C_WaitEvent(I2C_EVENT_MASTER_MODE_SELECT);
    I2C_Send7bitAddress(I2C1, OLED_ADDR, I2C_Direction_Transmitter);
    I2C_WaitEvent(I2C_EVENT_MASTER_TRANSMITTER_MODE_SELECTED);
    I2C_SendData(I2C1, 0x00);           /* control byte: command */
    I2C_WaitEvent(I2C_EVENT_MASTER_BYTE_TRANSMITTED);
    I2C_SendData(I2C1, cmd);
    I2C_WaitEvent(I2C_EVENT_MASTER_BYTE_TRANSMITTED);
    I2C_GenerateSTOP(I2C1, ENABLE);
}

static void OLED_WritePage(uint8_t page, const uint8_t *data)
{
    uint8_t i;
    I2C_WaitBusy();
    I2C_GenerateSTART(I2C1, ENABLE);
    I2C_WaitEvent(I2C_EVENT_MASTER_MODE_SELECT);
    I2C_Send7bitAddress(I2C1, OLED_ADDR, I2C_Direction_Transmitter);
    I2C_WaitEvent(I2C_EVENT_MASTER_TRANSMITTER_MODE_SELECTED);
    I2C_SendData(I2C1, 0x40);           /* control byte: data */
    I2C_WaitEvent(I2C_EVENT_MASTER_BYTE_TRANSMITTED);
    for (i = 0; i < OLED_W; i++) {
        I2C_SendData(I2C1, data[i]);
        I2C_WaitEvent(I2C_EVENT_MASTER_BYTE_TRANSMITTED);
    }
    I2C_GenerateSTOP(I2C1, ENABLE);
    (void)page;
}

static void OLED_SetCursor(uint8_t page, uint8_t col)
{
    col += OLED_COL_OFFSET;
    OLED_WriteCmd(0xB0 | page);
    OLED_WriteCmd(0x00 | (col & 0x0F));
    OLED_WriteCmd(0x10 | (col >> 4));
}

/* ============================================================================
 *  初始化序列（SH1106/SSD1306 兼容）
 * ============================================================================ */
void OLED_Init(void)
{
    uint8_t i;
    static const uint8_t init_seq[] = {
        0xAE,       /* display off */
        0xD5, 0x80, /* clock div: reset ratio, max freq */
        0xA8, 0x3F, /* multiplex 1/64 */
        0xD3, 0x00, /* display offset 0 */
        0x40,       /* start line 0 */
        0xAD, 0x8B, /* internal DC-DC on (SH1106) */
        0xA1,       /* segment remap: col127=SEG0 */
        0xC8,       /* COM scan: remapped */
        0xDA, 0x12, /* COM pins: alternative */
        0x81, 0xA0, /* contrast */
        0xD9, 0x22, /* pre-charge */
        0xDB, 0x35, /* VCOMH */
        0xA4,       /* entire display: follow RAM */
        0xA6,       /* normal (not inverted) */
        0xAF,       /* display on */
    };
    for (i = 0; i < sizeof(init_seq); i++)
        OLED_WriteCmd(init_seq[i]);

    OLED_Clear();
}

void OLED_Clear(void)
{
    memset(g_fb, 0, sizeof(g_fb));
    memset(g_fb_dirty, 1, sizeof(g_fb_dirty));
    OLED_Flush();
}

void OLED_MarkDirty(void)
{
    memset(g_fb_dirty, 1, sizeof(g_fb_dirty));
}

void OLED_Flush(void)
{
    uint8_t p;
    for (p = 0; p < OLED_PAGES; p++) {
        if (!g_fb_dirty[p]) continue;
        OLED_SetCursor(p, 0);
        OLED_WritePage(p, g_fb[p]);
        g_fb_dirty[p] = 0;
    }
}

/* ============================================================================
 *  帧缓存像素操作
 * ============================================================================ */
void FB_SetPixel(uint8_t x, uint8_t y)
{
    if (x >= OLED_W || y >= OLED_H) return;
    g_fb[y >> 3][x] |=  (uint8_t)(1 << (y & 7));
    g_fb_dirty[y >> 3] = 1;
}

void FB_ClrPixel(uint8_t x, uint8_t y)
{
    if (x >= OLED_W || y >= OLED_H) return;
    g_fb[y >> 3][x] &= (uint8_t)~(1 << (y & 7));
    g_fb_dirty[y >> 3] = 1;
}

void FB_FillRect(uint8_t x, uint8_t y, uint8_t w, uint8_t h, uint8_t fill)
{
    uint8_t row;
    uint8_t col;
    for (row = y; row < y + h; row++)
        for (col = x; col < x + w; col++) {
            if (fill) FB_SetPixel(col, row);
            else      FB_ClrPixel(col, row);
        }
}

void FB_DrawRect(uint8_t x, uint8_t y, uint8_t w, uint8_t h, uint8_t thick)
{
    uint8_t t;
    uint8_t col;
    uint8_t row;
    for (t = 0; t < thick; t++) {
        for (col = x+t; col < x+w-t; col++) {
            FB_SetPixel(col, y+t);
            FB_SetPixel(col, y+h-1-t);
        }
        for (row = y+t; row < y+h-t; row++) {
            FB_SetPixel(x+t, row);
            FB_SetPixel(x+w-1-t, row);
        }
    }
}

/* ============================================================================
 *  ASCII 8×16 字体
 *  格式：逐行，高位在左，每字 16 字节，ASCII 32..126
 *  本数据来自 ALIENTEK OLED 字库（公版嵌入式 8×16 字体）
 * ============================================================================ */
static const uint8_t g_font8x16[][16] = {
    {0x00,0x00,0x00,0x00,0x00,0x00,0x00,0x00,0x00,0x00,0x00,0x00,0x00,0x00,0x00,0x00},/*' '*/
    {0x00,0x00,0x18,0x3C,0x3C,0x3C,0x18,0x18,0x18,0x00,0x18,0x18,0x00,0x00,0x00,0x00},/*'!'*/
    {0x00,0x63,0x63,0x63,0x22,0x00,0x00,0x00,0x00,0x00,0x00,0x00,0x00,0x00,0x00,0x00},/*'"'*/
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    {0x00,0x00,0x71,0x5B,0x4E,0x00,0x00,0x00,0x00,0x00,0x00,0x00,0x00,0x00,0x00,0x00},/*'~'*/
};

/* ============================================================================
 *  汉字 16×16 字体
 *  格式：逐行高位在左，每字 32 字节（row0_hi, row0_lo, row1_hi, row1_lo ...）
 *  ！字模需要用 PCtoLCD2002（逐行，高位在左）提取后替换下方占位数据！
 *  CJK_CHAR_COUNT = 40，顺序与 app_oled.h 中 CJKIDX_xxx 一致
 * ============================================================================ */
static const uint8_t g_cjk16x16[CJK_CHAR_COUNT][32] = {
    /* 00 打 */
    {0x02,0x00,0x02,0x00,0xFF,0xFE,0x02,0x10,0x02,0x20,0x03,0xC0,0x02,0x40,
     0x04,0x40,0x04,0x40,0x08,0x42,0x10,0x42,0x20,0x42,0x40,0x42,0x00,0x42,0x00,0x3E,0x00,0x00},
    /* 01 印 */
    {0x04,0x00,0x04,0x00,0x04,0x00,0x7F,0xF0,0x04,0x10,0x04,0x10,0x04,0x10,
     0x04,0x10,0x04,0x10,0xFF,0xFE,0x00,0x10,0x00,0x10,0x00,0x10,0x00,0x10,0x00,0x10,0x00,0x00},
    /* 02 校 */
    {0x08,0x00,0x08,0x00,0xFF,0xFE,0x08,0x00,0x08,0x80,0x09,0xF0,0x0A,0x00,
     0x08,0x00,0x2F,0xF0,0x28,0x10,0x49,0xF0,0x49,0x10,0x89,0xF0,0x09,0x10,0x06,0x00,0x00,0x00},
    /* 03 准 */
    {0x00,0x40,0x7C,0x40,0x44,0x40,0x7C,0x40,0x44,0x7E,0x7C,0x40,0x00,0x40,
     0xFF,0xFE,0x00,0x40,0x7C,0x40,0x44,0x40,0x7C,0x40,0x44,0x40,0x7C,0x40,0x04,0x40,0x00,0x00},
    /* 04 扫 */
    {0x08,0x00,0x08,0x00,0x08,0x08,0xFF,0xFC,0x08,0x00,0x08,0x00,0x0F,0xF0,
     0x08,0x10,0x08,0x10,0x08,0x10,0x08,0x10,0x0F,0xF0,0x08,0x00,0x08,0x00,0x00,0x00,0x00,0x00},
    /* 05 码 */
    {0x00,0x08,0x7F,0xFC,0x02,0x08,0x01,0x00,0x3F,0xF0,0x01,0x10,0x01,0x10,
     0x3F,0xF0,0x01,0x10,0x01,0x10,0x3F,0xF0,0x01,0x10,0x01,0x10,0x3F,0xF0,0x01,0x00,0x00,0x00},
    /* 06 转 */
    {0x02,0x00,0x02,0x08,0xFF,0xFE,0x02,0x00,0x02,0x00,0x1F,0xF8,0x10,0x08,
     0x1F,0xF8,0x10,0x08,0x1F,0xF8,0x04,0x08,0x04,0x08,0x04,0x08,0x08,0x28,0x10,0x10,0x00,0x00},
    /* 07 速 */
    {0x00,0x00,0x07,0xF0,0x00,0x20,0xFF,0xFE,0x00,0x00,0x07,0xF0,0x04,0x10,
     0x07,0xF0,0x04,0x10,0x07,0xF0,0x00,0x00,0xFF,0xFE,0x04,0x10,0x0B,0x28,0x10,0xC6,0x00,0x00},
    /* 08 电 */
    {0x00,0x00,0x07,0xF8,0x04,0x08,0x04,0x08,0x04,0x08,0xFF,0xFE,0x04,0x08,
     0x04,0x08,0x04,0x08,0x04,0x08,0x07,0xF8,0x04,0x08,0x00,0x08,0x00,0x10,0x00,0x60,0x00,0x00},
    /* 09 流 */
    {0x01,0x00,0x00,0x80,0xFF,0xFE,0x00,0x00,0x01,0xF0,0x01,0x10,0x01,0x10,
     0xFF,0xFE,0x01,0x00,0x01,0xF0,0x01,0x10,0x01,0x10,0x01,0x10,0x05,0x50,0x08,0x20,0x00,0x00},
    /* 10 中 */
    {0x01,0x00,0x01,0x00,0x01,0x00,0x3F,0xF8,0x21,0x08,0x21,0x08,0x21,0x08,
     0xFF,0xFE,0x21,0x08,0x21,0x08,0x21,0x08,0x3F,0xF8,0x01,0x00,0x01,0x00,0x01,0x00,0x00,0x00},
    /* 11 完 */
    {0x01,0x00,0x01,0x00,0xFF,0xFE,0x01,0x00,0x02,0x80,0x02,0x40,0x04,0x40,
     0x18,0x30,0x27,0xCC,0x40,0x04,0x00,0x04,0x00,0x04,0x00,0x08,0x00,0x30,0x00,0x00,0x00,0x00},
    /* 12 成 */
    {0x10,0x00,0x13,0xFE,0x10,0x20,0x10,0x20,0xFF,0x20,0x10,0x20,0x10,0x20,
     0x13,0xFE,0x10,0x20,0x10,0x20,0x18,0x20,0x14,0x20,0x12,0x22,0x11,0xC2,0x00,0x02,0x00,0x00},
    /* 13 功 */
    {0x04,0x00,0x04,0x00,0x04,0x00,0x04,0x00,0xFF,0xFE,0x04,0x00,0x04,0x00,
     0x04,0x00,0x04,0x04,0x04,0x02,0x04,0x02,0x04,0x02,0x07,0xFE,0x04,0x00,0x00,0x00,0x00,0x00},
    /* 14 条 */
    {0x01,0x00,0x21,0x08,0x11,0x10,0x09,0x20,0x7F,0xFC,0x01,0x00,0x11,0x10,
     0x11,0x10,0x21,0x08,0x5F,0xF4,0x80,0x02,0x00,0x00,0x3F,0xF8,0x00,0x08,0x00,0x08,0x00,0x00},
    /* 15 内 */
    {0x00,0x00,0x3F,0xFC,0x20,0x04,0x20,0x04,0x20,0x04,0x27,0xC4,0x24,0x44,
     0x24,0x44,0x24,0x44,0x24,0x44,0x27,0xC4,0x24,0x04,0x20,0x04,0x20,0x04,0x3F,0xFC,0x00,0x00},
    /* 16 容 */
    {0x01,0x00,0x00,0x80,0x7F,0xFC,0x40,0x04,0x9F,0xF2,0x00,0x00,0x3F,0xF8,
     0x21,0x08,0x21,0x08,0x3F,0xF8,0x21,0x08,0x21,0x08,0x3F,0xF8,0x21,0x08,0x00,0x28,0x00,0x10},
    /* 17 失 */
    {0x00,0x00,0xFF,0xFE,0x01,0x00,0x01,0x00,0x01,0x00,0x1F,0xF0,0x01,0x00,
     0x01,0x00,0x01,0x00,0x3F,0xF8,0x01,0x00,0x01,0x04,0x01,0x04,0x01,0x04,0x01,0xFC,0x00,0x00},
    /* 18 败 */
    {0x10,0x20,0x18,0x40,0x10,0x80,0x11,0xF8,0xFE,0x10,0x14,0x20,0x24,0x40,
     0x44,0x80,0xC5,0x00,0x44,0xA0,0x44,0x90,0x44,0x88,0x44,0x84,0x44,0x82,0x40,0x82,0x00,0x00},
    /* 19 移 */
    {0x11,0x00,0x11,0x10,0x09,0x24,0x7F,0xFE,0x01,0x00,0x7F,0xFC,0x01,0x00,
     0xFF,0xFE,0x03,0x00,0x05,0x08,0x09,0x04,0x11,0x04,0x21,0x02,0x41,0x02,0x81,0x02,0x00,0x00},
    /* 20 开 */
    {0x00,0x00,0xFF,0xFE,0x04,0x20,0x04,0x20,0x04,0x20,0x04,0x20,0x7F,0xFC,
     0x04,0x20,0x04,0x20,0x04,0x20,0x04,0x20,0x04,0x22,0x04,0x22,0x08,0x1E,0x10,0x00,0x00,0x00},
    /* 21 管 */
    {0x1F,0xF0,0x10,0x10,0x1F,0xF0,0x00,0x00,0xFF,0xFE,0x04,0x10,0x04,0x28,
     0x04,0xC4,0xFF,0xFE,0x04,0x10,0x04,0x10,0x7F,0xFC,0x44,0x44,0x44,0x44,0x7F,0xFC,0x00,0x04},
    /* 22 后 */
    {0x00,0x00,0xFF,0xE0,0x01,0x00,0x01,0x00,0x01,0xF8,0xFF,0x08,0x01,0x08,
     0x01,0x08,0x01,0xF8,0x01,0x00,0x01,0x00,0x01,0x04,0x01,0x04,0x01,0x04,0x01,0xFC,0x00,0x00},
    /* 23 再 */
    {0x00,0x00,0x7F,0xFC,0x00,0x04,0x00,0x04,0x1F,0xE4,0x10,0x24,0x10,0x24,
     0xFF,0xE4,0x10,0x24,0x10,0x24,0x10,0x24,0x1F,0xE4,0x00,0x04,0x00,0x04,0x7F,0xFC,0x00,0x00},
    /* 24 次 */
    {0x00,0x40,0x78,0x40,0x08,0x40,0x08,0x40,0xFF,0xFE,0x08,0x40,0x18,0x40,
     0x28,0x40,0x48,0x42,0x09,0x42,0x0A,0x42,0x08,0x42,0x08,0x3E,0x08,0x00,0x08,0x00,0x00,0x00},
    /* 25 按 */
    {0x08,0x00,0x08,0x00,0xFF,0xFE,0x08,0x00,0x08,0x00,0x1F,0xE0,0x11,0x20,
     0x1F,0xE0,0x10,0x20,0x1F,0xE0,0x10,0x20,0x14,0x20,0x12,0x24,0x11,0x22,0x10,0x20,0x00,0x00},
    /* 26 键 */
    {0x08,0x10,0x08,0x10,0xFF,0xFE,0x08,0x10,0x08,0x10,0x7E,0x78,0x08,0x10,
     0x7E,0x78,0x08,0x10,0x7E,0x78,0x42,0x00,0x42,0x08,0x7E,0x1C,0x42,0x34,0x42,0x62,0x00,0x00},
    /* 27 请 */
    {0x01,0x00,0x01,0x10,0xFF,0xFE,0x01,0x10,0x7D,0x10,0x55,0xFE,0x55,0x10,
     0x7D,0x10,0x55,0x10,0x55,0xFE,0x7D,0x10,0x01,0x10,0x01,0x10,0x01,0x10,0xFF,0xFE,0x00,0x00},
    /* 28 查 */
    {0x01,0x00,0x21,0x08,0x11,0x10,0x09,0x20,0x05,0x40,0x03,0x80,0x01,0x00,
     0x3F,0xF8,0x21,0x08,0x21,0x08,0x3F,0xF8,0x21,0x08,0x21,0x08,0x3F,0xF8,0x21,0x08,0x00,0x00},
    /* 29 距 */
    {0x00,0x00,0x3F,0xFC,0x24,0x44,0x24,0x44,0x3F,0xFC,0x24,0x44,0x3F,0xFC,
     0x00,0x00,0xFF,0xFE,0x08,0x20,0x08,0x20,0x3F,0xF8,0x08,0x20,0x08,0x20,0xFF,0xFE,0x00,0x00},
    /* 30 离 */
    {0x01,0x00,0x01,0x00,0x3F,0xFC,0x21,0x04,0x21,0x04,0x21,0x04,0x21,0x04,
     0x21,0x04,0x3F,0xFC,0x00,0x00,0x7F,0xFE,0x40,0x02,0x40,0x02,0x7F,0xFE,0x40,0x02,0x00,0x00},
    /* 31 读 */
    {0x00,0x80,0x00,0x80,0xFF,0xFE,0x00,0x80,0x3E,0x80,0x22,0xA8,0x3E,0x90,
     0x22,0xA8,0x3E,0xC0,0x22,0x80,0x02,0xC0,0x02,0xA0,0x02,0x90,0x02,0x88,0x02,0x84,0x00,0x00},
    /* 32 取 */
    {0x1F,0xE0,0x10,0x20,0x10,0x20,0x1F,0xE0,0x10,0x20,0x10,0x20,0x1F,0xE0,
     0x04,0x00,0xFF,0xFE,0x04,0x40,0x04,0x40,0x04,0x42,0x08,0x42,0x10,0x42,0x60,0x3E,0x00,0x00},
    /* 33 样 */
    {0x04,0x00,0x04,0x00,0xFF,0xFE,0x04,0x20,0x1F,0xF0,0x10,0x10,0x1F,0xF0,
     0x10,0x10,0x1F,0xF0,0x10,0x10,0x1F,0xF0,0x00,0x00,0xFF,0xFE,0x00,0x00,0x00,0x00,0x00,0x00},
    /* 34 本 */
    {0x01,0x00,0x01,0x00,0x3F,0xF8,0x21,0x08,0x21,0x08,0x3F,0xF8,0x01,0x00,
     0x7F,0xFC,0x01,0x00,0x01,0x10,0x01,0x08,0x01,0x04,0x01,0x04,0x01,0x02,0x01,0x02,0x00,0x00},
    /* 35 试 */
    {0x00,0x40,0x7E,0x40,0x04,0x40,0x04,0x40,0xFF,0xFE,0x04,0x40,0x04,0x40,
     0x04,0x40,0x04,0x42,0x7E,0x44,0x04,0x4C,0x04,0x58,0x04,0x70,0x04,0x40,0x04,0x40,0x00,0x00},
    /* 36 检 */
    {0x08,0x00,0x08,0x00,0xFF,0xFE,0x08,0x00,0x3E,0xF8,0x22,0x08,0x3E,0xF8,
     0x22,0x08,0x3E,0xF8,0x22,0x08,0x22,0x08,0x23,0xF8,0x22,0x08,0x22,0x08,0x22,0x08,0x00,0x00},
    /* 37 DA label placeholder (can reuse 打) */
    {0x02,0x00,0x02,0x00,0xFF,0xFE,0x02,0x10,0x02,0x20,0x03,0xC0,0x02,0x40,
     0x04,0x40,0x04,0x40,0x08,0x42,0x10,0x42,0x20,0x42,0x40,0x42,0x00,0x42,0x00,0x3E,0x00,0x00},
    /* 38 光 */
    {0x01,0x00,0x01,0x00,0x7F,0xFC,0x01,0x00,0x1F,0xF0,0x03,0x00,0x05,0x00,
     0x09,0x00,0x11,0x04,0x21,0x04,0x41,0x04,0x01,0x04,0x01,0x04,0x01,0x04,0x01,0xFC,0x00,0x00},
    /* 39 开 (same as idx20) */
    {0x00,0x00,0xFF,0xFE,0x04,0x20,0x04,0x20,0x04,0x20,0x04,0x20,0x7F,0xFC,
     0x04,0x20,0x04,0x20,0x04,0x20,0x04,0x20,0x04,0x22,0x04,0x22,0x08,0x1E,0x10,0x00,0x00,0x00},
    /* === 以下 12 个为占位字模（空心框），需用 PCtoLCD2002 提取真实字模替换 === */
    /* 40 度 */
    {0xFF,0xFF,0x80,0x01,0x80,0x01,0x80,0x01,0x80,0x01,0x80,0x01,0x80,0x01,0x80,0x01,
     0x80,0x01,0x80,0x01,0x80,0x01,0x80,0x01,0x80,0x01,0x80,0x01,0x80,0x01,0xFF,0xFF},
    /* 41 通 */
    {0xFF,0xFF,0x80,0x01,0x80,0x01,0x80,0x01,0x80,0x01,0x80,0x01,0x80,0x01,0x80,0x01,
     0x80,0x01,0x80,0x01,0x80,0x01,0x80,0x01,0x80,0x01,0x80,0x01,0x80,0x01,0xFF,0xFF},
    /* 42 讯 */
    {0xFF,0xFF,0x80,0x01,0x80,0x01,0x80,0x01,0x80,0x01,0x80,0x01,0x80,0x01,0x80,0x01,
     0x80,0x01,0x80,0x01,0x80,0x01,0x80,0x01,0x80,0x01,0x80,0x01,0x80,0x01,0xFF,0xFF},
    /* 43 连 */
    {0xFF,0xFF,0x80,0x01,0x80,0x01,0x80,0x01,0x80,0x01,0x80,0x01,0x80,0x01,0x80,0x01,
     0x80,0x01,0x80,0x01,0x80,0x01,0x80,0x01,0x80,0x01,0x80,0x01,0x80,0x01,0xFF,0xFF},
    /* 44 接 */
    {0xFF,0xFF,0x80,0x01,0x80,0x01,0x80,0x01,0x80,0x01,0x80,0x01,0x80,0x01,0x80,0x01,
     0x80,0x01,0x80,0x01,0x80,0x01,0x80,0x01,0x80,0x01,0x80,0x01,0x80,0x01,0xFF,0xFF},
    /* 45 传 */
    {0xFF,0xFF,0x80,0x01,0x80,0x01,0x80,0x01,0x80,0x01,0x80,0x01,0x80,0x01,0x80,0x01,
     0x80,0x01,0x80,0x01,0x80,0x01,0x80,0x01,0x80,0x01,0x80,0x01,0x80,0x01,0xFF,0xFF},
    /* 46 感 */
    {0xFF,0xFF,0x80,0x01,0x80,0x01,0x80,0x01,0x80,0x01,0x80,0x01,0x80,0x01,0x80,0x01,
     0x80,0x01,0x80,0x01,0x80,0x01,0x80,0x01,0x80,0x01,0x80,0x01,0x80,0x01,0xFF,0xFF},
    /* 47 器 */
    {0xFF,0xFF,0x80,0x01,0x80,0x01,0x80,0x01,0x80,0x01,0x80,0x01,0x80,0x01,0x80,0x01,
     0x80,0x01,0x80,0x01,0x80,0x01,0x80,0x01,0x80,0x01,0x80,0x01,0x80,0x01,0xFF,0xFF},
    /* 48 靠 */
    {0xFF,0xFF,0x80,0x01,0x80,0x01,0x80,0x01,0x80,0x01,0x80,0x01,0x80,0x01,0x80,0x01,
     0x80,0x01,0x80,0x01,0x80,0x01,0x80,0x01,0x80,0x01,0x80,0x01,0x80,0x01,0xFF,0xFF},
    /* 49 近 */
    {0xFF,0xFF,0x80,0x01,0x80,0x01,0x80,0x01,0x80,0x01,0x80,0x01,0x80,0x01,0x80,0x01,
     0x80,0x01,0x80,0x01,0x80,0x01,0x80,0x01,0x80,0x01,0x80,0x01,0x80,0x01,0xFF,0xFF},
    /* 50 下 */
    {0xFF,0xFF,0x80,0x01,0x80,0x01,0x80,0x01,0x80,0x01,0x80,0x01,0x80,0x01,0x80,0x01,
     0x80,0x01,0x80,0x01,0x80,0x01,0x80,0x01,0x80,0x01,0x80,0x01,0x80,0x01,0xFF,0xFF},
    /* 51 回 */
    {0xFF,0xFF,0x80,0x01,0x80,0x01,0x80,0x01,0x80,0x01,0x80,0x01,0x80,0x01,0x80,0x01,
     0x80,0x01,0x80,0x01,0x80,0x01,0x80,0x01,0x80,0x01,0x80,0x01,0x80,0x01,0xFF,0xFF},
};

/* ============================================================================
 *  字符渲染
 * ============================================================================ */
void FB_DrawChar8x16(uint8_t x, uint8_t y, char c)
{
    const uint8_t *bmp;
    uint8_t row;
    if (c < 32 || c > 126) c = 32;
    bmp = g_font8x16[c - 32];
    for (row = 0; row < 16; row++) {
        uint8_t bits = bmp[row];
        uint8_t col;
        for (col = 0; col < 8; col++) {
            if (bits & (0x80 >> col)) FB_SetPixel(x + col, y + row);
            else                       FB_ClrPixel(x + col, y + row);
        }
    }
}

void FB_DrawStr8x16(uint8_t x, uint8_t y, const char *s)
{
    while (*s) {
        FB_DrawChar8x16(x, y, *s++);
        x += 8;
    }
}

void FB_DrawCJK(uint8_t x, uint8_t y, uint8_t idx)
{
    const uint8_t *bmp;
    uint8_t row;
    if (idx >= CJK_CHAR_COUNT) return;
    bmp = g_cjk16x16[idx];
    for (row = 0; row < 16; row++) {
        uint16_t bits = ((uint16_t)bmp[row * 2] << 8) | bmp[row * 2 + 1];
        uint8_t col;
        for (col = 0; col < 16; col++) {
            if (bits & (0x8000U >> col)) FB_SetPixel(x + col, y + row);
            else                          FB_ClrPixel(x + col, y + row);
        }
    }
}

void FB_DrawCJKStr(uint8_t x, uint8_t y, const uint8_t *idx_arr, uint8_t cnt)
{
    uint8_t i;
    for (i = 0; i < cnt; i++) {
        FB_DrawCJK(x, y, idx_arr[i]);
        x += 16;
    }
}

/* ============================================================================
 *  数值格式化 (纯整数, 无 printf/sprintf)
 * ============================================================================ */
static uint8_t uint_to_str(uint32_t v, char *buf)  /* 返回字符串长度 */
{
    char tmp[10];
    uint8_t n = 0;
    uint8_t i;
    if (v == 0) { buf[0] = '0'; buf[1] = '\0'; return 1; }
    while (v) { tmp[n++] = (char)('0' + (v % 10)); v /= 10; }
    for (i = 0; i < n; i++) buf[i] = tmp[n - 1 - i];
    buf[n] = '\0';
    return n;
}

/* 格式化 "N.N A" (Irun_To_mA10 返回 0.1A 单位) */
static void fmt_amp(char *buf, uint8_t irun)
{
    uint16_t ma10;
    char tmp[4];
    uint8_t i = 0;
    uint8_t k;
    ma10 = Irun_To_mA10(irun);
    uint_to_str(ma10 / 10, tmp);
    for (k = 0; tmp[k]; k++) buf[i++] = tmp[k];
    buf[i++] = '.';
    buf[i++] = (char)('0' + (ma10 % 10));
    buf[i++] = ' '; buf[i++] = 'A'; buf[i] = '\0';
}

/* ============================================================================
 *  圆形绘制（主界面光开关指示用）
 * ============================================================================ */

/* Bresenham 填充圆 */
static void FB_FillCircle(uint8_t cx, uint8_t cy, uint8_t r)
{
    int16_t x = (int16_t)r, y = 0, P = 1 - (int16_t)r;
    while (x >= y) {
        int16_t i;
        for (i = (int16_t)cx - x; i <= (int16_t)cx + x; i++) {
            if (i >= 0 && i < OLED_W) {
                if ((int16_t)cy + y >= 0 && (int16_t)cy + y < OLED_H)
                    FB_SetPixel((uint8_t)i, (uint8_t)((int16_t)cy + y));
                if ((int16_t)cy - y >= 0 && (int16_t)cy - y < OLED_H)
                    FB_SetPixel((uint8_t)i, (uint8_t)((int16_t)cy - y));
            }
        }
        for (i = (int16_t)cx - y; i <= (int16_t)cx + y; i++) {
            if (i >= 0 && i < OLED_W) {
                if ((int16_t)cy + x >= 0 && (int16_t)cy + x < OLED_H)
                    FB_SetPixel((uint8_t)i, (uint8_t)((int16_t)cy + x));
                if ((int16_t)cy - x >= 0 && (int16_t)cy - x < OLED_H)
                    FB_SetPixel((uint8_t)i, (uint8_t)((int16_t)cy - x));
            }
        }
        y++;
        if (P <= 0) P += 2 * y + 1;
        else        { x--; P += 2 * (y - x) + 1; }
    }
}

/* Bresenham 圆环 */
static void FB_DrawCircleRing(uint8_t cx, uint8_t cy, uint8_t r)
{
    int16_t x = (int16_t)r, y = 0, P = 1 - (int16_t)r;
    while (x >= y) {
#define _SP(a,b) do { \
    int16_t _px=(int16_t)cx+(a), _py=(int16_t)cy+(b); \
    if(_px>=0&&_px<OLED_W&&_py>=0&&_py<OLED_H) FB_SetPixel((uint8_t)_px,(uint8_t)_py); \
} while(0)
        _SP( x, y); _SP(-x, y); _SP( x,-y); _SP(-x,-y);
        _SP( y, x); _SP(-y, x); _SP( y,-x); _SP(-y,-x);
#undef _SP
        y++;
        if (P <= 0) P += 2 * y + 1;
        else        { x--; P += 2 * (y - x) + 1; }
    }
}

/* ============================================================================
 *  主界面新版布局常量
 *  两张全宽卡片 (110px wide) + 右侧光开关圆圈 + 右上角 R 循环指示
 * ============================================================================ */
#define HOME_CARD_W  110
#define HOME_CARD_H   31
#define HOME_M1_Y      0
#define HOME_M2_Y     33
#define HOME_CIRC_X  119   /* 圆心 X */
#define HOME_CIRC_R    6   /* 半径 */
#define HOME_CIRC_M1Y  15  /* M1 圆心 Y = HOME_M1_Y + HOME_CARD_H/2 */
#define HOME_CIRC_M2Y  48  /* M2 圆心 Y = HOME_M2_Y + HOME_CARD_H/2 */

/* 绘制一张电机卡片（HOME 新版） */
static void Draw_Home_Card(uint8_t motor, uint8_t focused)
{
    uint8_t  y    = (motor == 1) ? HOME_M1_Y : HOME_M2_Y;
    uint16_t rpm  = (motor == 1) ? g_cfg.m1_rpm  : g_cfg.m2_rpm;
    uint8_t  irun = (motor == 1) ? g_cfg.m1_irun : g_cfg.m2_irun;
    uint16_t ma10 = Irun_To_mA10(irun);
    char  buf[20];
    char  tmp[6];
    uint8_t i = 0, k;

    FB_FillRect(0, y, HOME_CARD_W, HOME_CARD_H, 0);

    /* 组合字符串 "M1-300R-1.1A" */
    buf[i++] = 'M';
    buf[i++] = (char)('0' + motor);
    buf[i++] = '-';
    uint_to_str(rpm, tmp);
    for (k = 0; tmp[k]; k++) buf[i++] = tmp[k];
    buf[i++] = 'R';
    buf[i++] = '-';
    uint_to_str(ma10 / 10, tmp);
    for (k = 0; tmp[k]; k++) buf[i++] = tmp[k];
    buf[i++] = '.';
    buf[i++] = (char)('0' + (ma10 % 10));
    buf[i++] = 'A';
    buf[i]   = '\0';

    /* 文字垂直居中（16px 字高在 HOME_CARD_H=31 中：(31-16)/2=7） */
    FB_DrawStr8x16(4, y + 7, buf);

    /* 边框：选中=2px 粗，未选=无边框 */
    if (focused)
        FB_DrawRect(0, y, HOME_CARD_W, HOME_CARD_H, 2);
}

/* 绘制一个光开关圆圈（HOME 新版）
 *  state=1（遮挡/L）→ 空心圆；state=0（通透/H）→ 实心圆 */
static void Draw_Home_Circle(uint8_t n, uint8_t state)
{
    uint8_t cy = (n == 1) ? HOME_CIRC_M1Y : HOME_CIRC_M2Y;
    /* 清除圆圈区域 */
    FB_FillRect((uint8_t)(HOME_CIRC_X - HOME_CIRC_R - 1),
                (uint8_t)(cy - HOME_CIRC_R - 1),
                (uint8_t)((HOME_CIRC_R + 2) * 2),
                (uint8_t)((HOME_CIRC_R + 2) * 2), 0);
    if (state)
        FB_DrawCircleRing(HOME_CIRC_X, cy, HOME_CIRC_R);   /* L/遮挡 → 空心圆 */
    else
        FB_FillCircle(HOME_CIRC_X, cy, HOME_CIRC_R);       /* H/通透 → 实心圆 */
}

/* ============================================================================
 *  UI 固定区域绘制（左/右/底，供子界面使用，保持不变）
 * ============================================================================ */
#define CARD_W   40    /* 增宽：M标签与电流值之间留8px视觉间距 */
#define CARD_H   32
#define CENTER_X 40    /* 随 CARD_W 右移 */
#define CENTER_W 56    /* 128 - CARD_W(40) - RIGHT_COL(32) */
#define RIGHT_X  96

static void Draw_M_Card(uint8_t motor, uint8_t is_focused)
{
    uint8_t  y    = (motor == 1) ? 0 : 32;
    uint8_t  irun = (motor == 1) ? g_cfg.m1_irun : g_cfg.m2_irun;
    uint16_t r    = (motor == 1) ? g_cfg.m1_rpm  : g_cfg.m2_rpm;
    uint16_t ma10;
    uint8_t  len;
    uint8_t  xr;
    char     buf[8];

    FB_FillRect(0, y, CARD_W, CARD_H, 0);

    /* Line 1: 1px left/right padding inside CARD_W=40 (border at x=0 and x=39)
       M  x=1..8, digit x=9..16, gap x=17..22,
       int_A x=23..30, dot x=28/29, frac_A x=31..38 */
    ma10 = Irun_To_mA10(irun);
    FB_DrawChar8x16(1,  y + 0, 'M');
    FB_DrawChar8x16(9,  y + 0, (char)('0' + motor));
    FB_DrawChar8x16(23, y + 0, (char)('0' + (ma10 / 10)));
    FB_SetPixel(28, y + 13); FB_SetPixel(29, y + 13);
    FB_SetPixel(28, y + 14); FB_SetPixel(29, y + 14);
    FB_DrawChar8x16(31, y + 0, (char)('0' + (ma10 % 10)));

    /* Line 2: RPM centered; clamp xr >= 1 for 1px left padding */
    len = uint_to_str(r, buf);
    xr  = (uint8_t)((CARD_W - (uint8_t)(len * 8)) / 2);
    if (xr < 1) xr = 1;
    FB_DrawStr8x16(xr, y + 16, buf);

    /* Border only when this card is selected */
    if (is_focused) {
        FB_DrawRect(0, y, CARD_W, CARD_H, 1);
    }
}

static void Draw_Right_Buttons(HomeFocus focus)
{
    /* 右列 32px 宽（x=96..127），3 个按钮 */
    static const uint8_t btn_y[3] = {0, 22, 43};
    static const uint8_t btn_h[3] = {22, 21, 21};
    static const char   *btn_labels[3] = {"PRT", "CAL", "SCN"};
    static const HomeFocus btn_focus[3] = {FOCUS_PRINT, FOCUS_CALIB, FOCUS_SCAN};
    uint8_t i;
    uint8_t col;

    FB_FillRect(RIGHT_X, 0, 32, 64, 0);

    /* 按钮间分隔线 */
    for (col = RIGHT_X; col < RIGHT_X + 32; col++) {
        FB_SetPixel(col, 21);
        FB_SetPixel(col, 42);
    }

    for (i = 0; i < 3; i++) {
        uint8_t y  = btn_y[i];
        uint8_t h  = btn_h[i];
        uint8_t cy = y + (uint8_t)((h - 16) / 2);  /* 16px 字体垂直居中 */

        if (focus == btn_focus[i])
            FB_DrawRect(RIGHT_X, y, 32, h, 1);

        /* 3 ASCII × 8px = 24px，居中于 32px 列 → offset 4px */
        FB_DrawStr8x16(RIGHT_X + 4, cy, btn_labels[i]);
    }
}

static void Draw_Status_Bar(void)
{
    /* 底部 GPI 状态条 y=48..63，格式 "1H2L"：
       1H=GPI1 高电平触发，1L=未触发；2H/2L 同理
       4 chars × 8px = 32px，居中于 56px 中心列 */
    FB_FillRect(CENTER_X, 48, CENTER_W, 16, 0);
    FB_DrawChar8x16(CENTER_X + 12, 48, '1');
    FB_DrawChar8x16(CENTER_X + 20, 48, g_opt_sw1 ? 'H' : 'L');
    FB_DrawChar8x16(CENTER_X + 28, 48, '2');
    FB_DrawChar8x16(CENTER_X + 36, 48, g_opt_sw2 ? 'H' : 'L');
}

static void Draw_Temp(void)
{
    /* 温度区：中央顶部，与底部 1H2L 状态栏左对齐（x = CENTER_X + 12） */
    uint16_t raw = g_temp_raw;
    uint16_t deg = raw >> 4;       /* 占位: raw/16 作为摄氏度显示 */
    char buf[8];
    uint8_t len = 0;
    uint_to_str(deg, buf);
    while (buf[len]) len++;
    buf[len++] = ' '; buf[len++] = 'C'; buf[len] = '\0';
    FB_FillRect(CENTER_X, 0, CENTER_W, 16, 0);
    FB_DrawStr8x16(CENTER_X + 12, 0, buf);   /* 与 Draw_Status_Bar 的 '1' 同一 X */
}

/* ============================================================================
 *  UI 渲染：各状态
 * ============================================================================ */

void UI_Render_Home(void)
{
    OLED_Clear();

    Draw_Home_Card(1, g_home_focus == FOCUS_M1);
    Draw_Home_Card(2, g_home_focus == FOCUS_M2);

    /* 光开关圆圈：L=实心，H=空心 */
    Draw_Home_Circle(1, g_opt_sw1);
    Draw_Home_Circle(2, g_opt_sw2);

    /* 循环模式指示：R 绘制在最后，纵向居中（y=24） */
    if (g_loop_mode)
        FB_DrawChar8x16(120, 24, 'R');

    OLED_MarkDirty();
    OLED_Flush();
}

/* ============================================================================
 *  全屏 UI 辅助：外框 + 居中绘制
 * ============================================================================ */

/* 全屏外框（1px，沿屏幕边缘） */
static void Draw_Outer_Frame(void)
{
    FB_DrawRect(0, 0, OLED_W, OLED_H, 1);
}

/* 居中绘制 ASCII 字符串（n 字符 × 8px） */
static void FB_DrawStr_Center(uint8_t y, const char *s, uint8_t total_w)
{
    uint8_t n = 0;
    uint8_t x;
    while (s[n]) n++;
    if (n * 8 >= total_w) { FB_DrawStr8x16(0, y, s); return; }
    x = (uint8_t)((total_w - (uint8_t)(n * 8)) / 2);
    FB_DrawStr8x16(x, y, s);
}

/* ============================================================================
 *  电机菜单 / 速度编辑 / 电流编辑 —— 全屏分屏
 *  布局: 外框 + 中间竖线 x=64 分隔；左=速度,右=电流；聚焦面板加内框
 * ============================================================================ */
static void Draw_Motor_FullScreen(uint8_t speed_focus, uint8_t cur_focus,
                                  uint16_t rpm, uint8_t irun)
{
    char buf[8];
    uint16_t ma10;
    uint8_t row;

    OLED_Clear();
    Draw_Outer_Frame();

    /* 中间竖直分隔线 x=64，从 y=2 到 y=61 */
    for (row = 2; row < OLED_H - 2; row++) FB_SetPixel(64, row);

    /* === 左面板 (x=0..63)：速度 === */
    uint_to_str(rpm, buf);
    FB_DrawStr_Center(10, buf, 64);
    FB_DrawStr_Center(34, "RPM", 64);                 /* 3×8=24px */
    if (speed_focus) FB_DrawRect(4, 4, 56, 56, 1);

    /* === 右面板 (x=65..127)：电流（0.X A） === */
    ma10 = Irun_To_mA10(irun);
    {
        char tmp[8];
        uint8_t i = 0;
        uint8_t k;
        uint_to_str(ma10 / 10, tmp);
        for (k = 0; tmp[k]; k++) buf[i++] = tmp[k];
        buf[i++] = '.';
        buf[i++] = (char)('0' + (ma10 % 10));
        buf[i] = '\0';
    }
    {
        uint8_t n = 0;
        uint8_t x;
        while (buf[n]) n++;
        x = (uint8_t)(65 + (63 - (uint8_t)(n * 8)) / 2);
        FB_DrawStr8x16(x, 10, buf);
    }
    /* "AMP" 标签居中于右面板 */
    {
        uint8_t x = (uint8_t)(65 + (63 - 24) / 2);
        FB_DrawStr8x16(x, 34, "AMP");
    }
    if (cur_focus) FB_DrawRect(68, 4, 56, 56, 1);

    OLED_MarkDirty();
    OLED_Flush();
}

void UI_Render_MotorMenu(void)
{
    uint16_t rpm  = (g_edit_motor == 1) ? g_cfg.m1_rpm  : g_cfg.m2_rpm;
    uint8_t  irun = (g_edit_motor == 1) ? g_cfg.m1_irun : g_cfg.m2_irun;
    Draw_Motor_FullScreen(g_motor_focus == MOTOR_FOCUS_SPEED,
                          g_motor_focus == MOTOR_FOCUS_CUR,
                          rpm, irun);
}

void UI_Render_SpeedEdit(void)
{
    /* 编辑速度：左面板显示草稿值并加焦点框，右面板显示当前电流 */
    uint8_t irun = (g_edit_motor == 1) ? g_cfg.m1_irun : g_cfg.m2_irun;
    Draw_Motor_FullScreen(1, 0, g_draft_rpm, irun);
}

void UI_Render_CurEdit(void)
{
    /* 编辑电流：右面板显示草稿电流并加焦点框，左面板显示当前速度 */
    uint16_t rpm = (g_edit_motor == 1) ? g_cfg.m1_rpm : g_cfg.m2_rpm;
    Draw_Motor_FullScreen(0, 1, rpm, g_draft_irun);
}

/* ============================================================================
 *  打印 —— 全屏外框 + 居中文字
 * ============================================================================ */
void UI_Render_Print_Running(void)
{
    OLED_Clear();
    Draw_Outer_Frame();
    /* "PRINTING" 8×8=64px, y=24 居中 */
    FB_DrawStr_Center(24, "PRINTING", OLED_W);
    OLED_MarkDirty();
    OLED_Flush();
}

void UI_Render_Print_Done(void)
{
    OLED_Clear();
    Draw_Outer_Frame();
    /* "PRINT OK" 8×8=64px */
    FB_DrawStr_Center(24, "PRINT OK", OLED_W);
    OLED_MarkDirty();
    OLED_Flush();
}

/* ============================================================================
 *  扫码 —— 全屏外框 + 结果文字
 * ============================================================================ */
void UI_Render_Scan(const char *result)
{
    OLED_Clear();
    Draw_Outer_Frame();

    if (!result) {
        /* 等待中：显示 "SCAN..." */
        FB_DrawStr_Center(24, "SCAN...", OLED_W);
    } else {
        /* 结果分两行显示，每行最多 14 个 ASCII (×8=112px，左右各留 8px) */
        char line1[15] = {0}, line2[15] = {0};
        uint8_t len = 0;
        uint8_t l1, i;
        while (result[len] && len < 28) len++;
        l1 = (len > 14) ? 14 : len;
        for (i = 0; i < l1; i++) line1[i] = result[i];
        if (len > 14) {
            uint8_t l2 = (len - 14 > 14) ? 14 : (uint8_t)(len - 14);
            uint8_t j;
            for (j = 0; j < l2; j++) line2[j] = result[14 + j];
        }
        FB_DrawStr_Center(16, line1, OLED_W);
        if (line2[0]) FB_DrawStr_Center(36, line2, OLED_W);
    }

    OLED_MarkDirty();
    OLED_Flush();
}

void UI_Render_Scan_Fail(void)
{
    OLED_Clear();
    Draw_Outer_Frame();
    /* "SCAN FAIL" 9×8=72px */
    FB_DrawStr_Center(24, "SCAN FAIL", OLED_W);
    OLED_MarkDirty();
    OLED_Flush();
}

/* ============================================================================
 *  校准 —— 全屏外框 + 双行提示
 * ============================================================================ */

/* 校准成功 -> "CAL OK / PRESS TO READ" */
void UI_Render_Cal_Step1_OK(void)
{
    OLED_Clear();
    Draw_Outer_Frame();
    FB_DrawStr_Center(12, "CAL OK",        OLED_W);  /* 6×8=48px  */
    FB_DrawStr_Center(36, "PRESS TO READ", OLED_W);  /* 13×8=104px */
    OLED_MarkDirty();
    OLED_Flush();
}

/* 校准失败 -> "CAL FAIL / MOVE CLOSER" */
void UI_Render_Cal_Step1_Fail(void)
{
    OLED_Clear();
    Draw_Outer_Frame();
    FB_DrawStr_Center(12, "CAL FAIL",    OLED_W);    /* 8×8=64px */
    FB_DrawStr_Center(36, "MOVE CLOSER", OLED_W);    /* 11×8=88px */
    OLED_MarkDirty();
    OLED_Flush();
}

/* 通讯失败 -> "COMM FAIL / CHECK SENSOR" */
void UI_Render_Cal_Comm_Fail(void)
{
    OLED_Clear();
    Draw_Outer_Frame();
    FB_DrawStr_Center(12, "COMM FAIL",    OLED_W);   /* 9×8=72px */
    FB_DrawStr_Center(36, "CHECK SENSOR", OLED_W);   /* 12×8=96px */
    OLED_MarkDirty();
    OLED_Flush();
}

/* 回读成功 -> "  11   875   4 / AGC  LED  REF"
   外框 128×64 内，3 列等分；每列宽 ~40px，标签 3 chars×8=24px */
void UI_Render_Cal_Step2_OK(uint8_t agc, uint16_t led, uint8_t ref)
{
    char buf[6];
    uint8_t n;
    uint8_t cx;
    /* 3 列中心 x: AGC≈20, LED≈64, REF≈108 */
    static const uint8_t COL_CX[3] = {20, 64, 108};

    OLED_Clear();
    Draw_Outer_Frame();

    /* ---- 数值行 y=12 ---- */
    /* AGC */
    n = uint_to_str(agc, buf);
    cx = (uint8_t)(COL_CX[0] - (uint8_t)(n * 8) / 2);
    FB_DrawStr8x16(cx, 12, buf);
    /* LED */
    n = uint_to_str(led, buf);
    cx = (uint8_t)(COL_CX[1] - (uint8_t)(n * 8) / 2);
    FB_DrawStr8x16(cx, 12, buf);
    /* REF */
    n = uint_to_str(ref, buf);
    cx = (uint8_t)(COL_CX[2] - (uint8_t)(n * 8) / 2);
    FB_DrawStr8x16(cx, 12, buf);

    /* ---- 标签行 y=36：每个 3 字符宽 24px，居中于列中心 ---- */
    FB_DrawStr8x16((uint8_t)(COL_CX[0] - 12), 36, "AGC");
    FB_DrawStr8x16((uint8_t)(COL_CX[1] - 12), 36, "LED");
    FB_DrawStr8x16((uint8_t)(COL_CX[2] - 12), 36, "REF");

    OLED_MarkDirty();
    OLED_Flush();
}

/* Step2 回读失败 -> "READ FAIL / REMOVE TUBE" */
void UI_Render_Cal_Step2_Fail(void)
{
    OLED_Clear();
    Draw_Outer_Frame();
    FB_DrawStr_Center(12, "READ FAIL",   OLED_W);    /* 9×8=72px */
    FB_DrawStr_Center(36, "REMOVE TUBE", OLED_W);    /* 11×8=88px */
    OLED_MarkDirty();
    OLED_Flush();
}

/* ============================================================================
 *  叠加层：温度 / 状态条 —— 全屏 UI 下不绘制（仅 HOME 状态有效）
 * ============================================================================ */
void UI_Render_Overlay_Temp(void)
{
    /* 新主界面隐藏温度，此函数为空操作 */
}

void UI_Render_Overlay_Status(void)
{
    if (g_state != STATE_HOME) return;
    /* 更新光开关圆圈；R 绘制在最后防止被圆圈清除区域覆盖 */
    Draw_Home_Circle(1, g_opt_sw1);
    Draw_Home_Circle(2, g_opt_sw2);
    if (g_loop_mode)
        FB_DrawChar8x16(120, 24, 'R');
    OLED_MarkDirty();
    OLED_Flush();
}

/* ============================================================================
 *  编辑态值闪烁 —— 仅清/绘 value 区域（y=10..25），其余像素保持
 *  on=1 显示值, on=0 隐藏值，外层 500ms 节拍切换
 * ============================================================================ */
void UI_BlinkValue_Speed(uint8_t on)
{
    /* 左面板值区域 x=2..61 (60px), y=10..25 (16px) */
    FB_FillRect(2, 10, 60, 16, 0);
    if (on) {
        char buf[8];
        uint8_t n;
        uint8_t x;
        n = uint_to_str(g_draft_rpm, buf);
        x = (uint8_t)((64 - (uint8_t)(n * 8)) / 2);
        if (x < 2) x = 2;
        FB_DrawStr8x16(x, 10, buf);
    }
    /* 跨页 1(y=8..15) 和页 2(y=16..23) 和页 3(y=24..31, 仅 24,25 有变化) */
    g_fb_dirty[1] = 1;
    g_fb_dirty[2] = 1;
    g_fb_dirty[3] = 1;
    OLED_Flush();
}

void UI_BlinkValue_Cur(uint8_t on)
{
    /* 右面板值区域 x=68..123 (56px), y=10..25 */
    FB_FillRect(68, 10, 56, 16, 0);
    if (on) {
        char buf[8];
        uint8_t i = 0;
        uint8_t k;
        uint16_t ma10 = Irun_To_mA10(g_draft_irun);
        char tmp[8];
        uint8_t n = 0;
        uint8_t x;
        uint_to_str(ma10 / 10, tmp);
        for (k = 0; tmp[k]; k++) buf[i++] = tmp[k];
        buf[i++] = '.';
        buf[i++] = (char)('0' + (ma10 % 10));
        buf[i] = '\0';
        while (buf[n]) n++;
        x = (uint8_t)(65 + (63 - (uint8_t)(n * 8)) / 2);
        FB_DrawStr8x16(x, 10, buf);
    }
    g_fb_dirty[1] = 1;
    g_fb_dirty[2] = 1;
    g_fb_dirty[3] = 1;
    OLED_Flush();
}
